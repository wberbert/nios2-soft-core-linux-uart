## buildroot-2018.02.9/configs/nios2_defconfig
```kconfig
BR2_nios2=y
BR2_TOOLCHAIN_EXTERNAL_CUSTOM=y
BR2_TOOLCHAIN_EXTERNAL_PATH="/opt/sourceryg++-2018.05"
BR2_TOOLCHAIN_EXTERNAL_CUSTOM_PREFIX="$(ARCH)-linux-gnu"
BR2_TOOLCHAIN_EXTERNAL_CUSTOM_GLIBC=y
BR2_TARGET_GENERIC_HOSTNAME="nios2"
BR2_TARGET_GENERIC_ISSUE="Welcome to Nios II"
BR2_TARGET_GENERIC_GETTY_PORT="ttyJ0"
BR2_TARGET_ROOTFS_CPIO=y
BR2_TARGET_ROOTFS_JFFS2=y
```
